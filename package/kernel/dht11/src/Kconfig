## package/kernel/dht11/src/Kconfig
```kconfig
config DHT11-DRIVER 
     tristate "DHT11-driver"
     default m
     help 
         This is DHT11 driver module 
```

## package/kernel/gpio-int/src/Kconfig
```kconfig
config MIDAS-DRIVER
	tristate "GPIO-INT-TEST"
        default m
	help
	  This is an test for GPIO interrupt test.
```

## package/kernel/kdraw/src/Kconfig
```kconfig
config KDRAW
tristate "kdraw"
default m
help
   This is a kernel driver for spi draw
```
